## CMakeLists.txt
```
# SPDX-License-Identifier: Apache-2.0

cmake_minimum_required(VERSION 3.20.0)

# The sample app consumes the library the same way any other application
# would: through the Zephyr module in this repository (zephyr/module.yml).
list(APPEND ZEPHYR_EXTRA_MODULES ${CMAKE_CURRENT_SOURCE_DIR})

find_package(Zephyr REQUIRED HINTS $ENV{ZEPHYR_BASE})

project(http_server_bare CXX)

target_sources(app PRIVATE
  src/main.cpp
  src/uart_bridge.cpp
)
```

## Kconfig
```
# Copyright (c) 2026 Zephyr Project contributors
# SPDX-License-Identifier: Apache-2.0

mainmenu "Bare HTTP server sample"

config APP_SELFTEST
	bool "Inject canned requests at startup"
	default y
	help
	  Feed a few keep-alive requests into the server at boot, on the same
	  connection the UART uses. Lets the sample demonstrate that one
	  connection serves many requests without a terminal attached.

source "Kconfig.zephyr"
```

## sample.yaml
```
sample:
  description: Download and upload files over a UART with bare data buffers, without
    a network stack
  name: http_server_bare_sample
common:
  harness: console
  harness_config:
    type: multi_line
    ordered: true
    regex:
      - "UART .* wired to the HTTP server"
      - "request 1: feeding .* bytes in two chunks"
      - "GET /lfs/hello.txt"
      - "request 2: feeding .* bytes in two chunks"
      - "PUT /lfs/upload.txt"
      - "request 3: feeding .* bytes in two chunks"
      - "GET /lfs/upload.txt"
      - "request 4: feeding .* bytes in two chunks"
      - "GET /files/missing.txt"
      - "Self-test done"
  tags:
    - http
    - uart
    - filesystem
  integration_platforms:
    - native_sim
tests:
  sample.net.http.server.bare: {}
```

## west.yml
```
# Copyright (c) 2026 Zephyr Project contributors
# SPDX-License-Identifier: Apache-2.0
#
# West manifest for building this application as its own workspace:
#
#   mkdir bare-http && cd bare-http
#   git clone <this repo> zephyr-http-server-raw
#   west init -l zephyr-http-server-raw
#   west update
#   west build -b native_sim zephyr-http-server-raw
#
# Only littlefs is pulled in besides Zephyr itself: the sample needs no HALs on
# native_sim and no other modules. Extend name-allowlist when targeting real
# hardware that needs its vendor HAL.

manifest:
  self:
    path: zephyr-http-server-raw

  remotes:
    - name: zephyrproject-rtos
      url-base: https://github.com/zephyrproject-rtos

  projects:
    - name: zephyr
      remote: zephyrproject-rtos
      revision: v4.4.0
      import:
        name-allowlist:
          - littlefs
```

## prj.conf
```kconfig
CONFIG_MAIN_STACK_SIZE=4096
CONFIG_LOG=y
CONFIG_PRINTK=y

# C++
CONFIG_CPP=y
CONFIG_STD_CPP17=y

# The UART bridge: interrupt-driven RX on the http-uart alias, buffered
# through a ring until the feed thread hands it to the server.
CONFIG_SERIAL=y
CONFIG_UART_INTERRUPT_DRIVEN=y
CONFIG_RING_BUFFER=y

# The library. RAW_HTTP_SERVER selects NETWORKING (only to reach the HTTP
# parser's Kconfig) and HTTP_PARSER, and its module Kconfig defaults the
# native IP stack off.
CONFIG_RAW_HTTP_SERVER=y

# The one thing the module cannot default away: native_sim's own
# Kconfig.defconfig turns Ethernet on whenever networking is in the build,
# and board defaults deliberately outrank module defaults. The TAP driver
# falls away with it.
CONFIG_NET_L2_ETHERNET=n

# Filesystem the server serves files from and uploads into. A real board would
# already have this mounted; native_sim gets a littlefs on the flash simulator
# so the sample has somewhere to put files.
CONFIG_FLASH=y
CONFIG_FLASH_MAP=y
CONFIG_FILE_SYSTEM=y
CONFIG_FILE_SYSTEM_LITTLEFS=y
```

## boards/native_sim.overlay
```dts
/*
 * Copyright (c) 2026 Zephyr Project contributors
 *
 * SPDX-License-Identifier: Apache-2.0
 */

/ {
	aliases {
		/* uart0 stays on the console so the logs remain readable. */
		http-uart = &uart1;
	};
};

&uart1 {
	status = "okay";
};

/*
 * native_sim's stock storage partition is 16 KiB, and littlefs metadata eats
 * most of that - seeding the demo files would fail with -ENOSPC. Grow it into
 * the unused top half of the 2 MiB simulated flash so the sample has room for
 * real files.
 */
&storage_partition {
	reg = <0x000fc000 0x00100000>;
};
```

## boards/native_sim_native_64.overlay
```dts
/*
 * Copyright (c) 2026 Zephyr Project contributors
 *
 * SPDX-License-Identifier: Apache-2.0
 */

/ {
	aliases {
		/* uart0 stays on the console so the logs remain readable. */
		http-uart = &uart1;
	};
};

&uart1 {
	status = "okay";
};

/*
 * native_sim's stock storage partition is 16 KiB, and littlefs metadata eats
 * most of that - uploads fail with -ENOSPC after a few hundred bytes. Grow it
 * into the unused top half of the 2 MiB simulated flash so the sample has room
 * for real files.
 */
&storage_partition {
	reg = <0x000fc000 0x00100000>;
};
```

## boards/nucleo_u5a5zj_q.overlay
```dts
/*
 * Copyright (c) 2026 Zephyr Project contributors
 *
 * SPDX-License-Identifier: Apache-2.0
 */

/ {
	aliases {
		/* The HTTP byte stream rides the Arduino D1/D0 pins; the
		 * console keeps the ST-Link VCP on usart1.
		 */
		http-uart = &lpuart1;
	};
};

/* Arduino D1 is LPUART1_TX on PG7, D0 is LPUART1_RX on PG8. The board dts
 * leaves lpuart1 untouched, so pins and speed are set here. The board's own
 * 120 KiB storage_partition provides the littlefs backing store.
 */
&lpuart1 {
	pinctrl-0 = <&lpuart1_tx_pg7 &lpuart1_rx_pg8>;
	pinctrl-names = "default";
	current-speed = <115200>;
	status = "okay";
};
```

## src/main.c
```c
/*
 * Copyright (c) 2026 Zephyr Project contributors
 *
 * SPDX-License-Identifier: Apache-2.0
 */

/**
 * @file
 * @brief Driving the Zephyr HTTP server with bare data buffers.
 *
 * The HTTP server runs completely unmodified, but there is no network stack
 * underneath it: no L2 driver, no IP, no TCP. Requests are handed over as raw
 * byte buffers through bare_http_input(), and responses come back as raw byte
 * buffers through the registered bare_http_out_cb_t.
 */

#include <stdio.h>
#include <string.h>

#include <zephyr/kernel.h>
#include <zephyr/logging/log.h>
#include <zephyr/net/http/server.h>
#include <zephyr/net/http/service.h>

#include "bare_transport.h"

LOG_MODULE_REGISTER(net_http_server_bare, LOG_LEVEL_INF);

/*
 * The HTTP server builds a sockaddr before it calls the socket_create hook,
 * so a service still needs a host and a port even though neither is used.
 * Keep the port non-zero: a zero port means "ephemeral", which would make the
 * server call getsockname() on the bare listening socket.
 */
static uint16_t bare_port = 80;

static const struct http_service_config bare_config = {
	.socket_create = bare_http_listener_create,
};

HTTP_SERVICE_DEFINE(bare_service, NULL, &bare_port, 1, 1, NULL, NULL, &bare_config);

/* A static resource, served straight out of flash. */
static const char index_html[] =
	"<html><body><h1>Zephyr HTTP server, no network attached</h1></body></html>";

static struct http_resource_detail_static index_html_resource_detail = {
	.common = {
		.type = HTTP_RESOURCE_TYPE_STATIC,
		.bitmask_of_supported_http_methods = BIT(HTTP_GET),
		.content_type = "text/html",
	},
	.static_data = index_html,
	.static_data_len = sizeof(index_html) - 1,
};

HTTP_RESOURCE_DEFINE(index_html_resource, bare_service, "/", &index_html_resource_detail);

/* A dynamic resource, to show that application handlers work as usual. */
static int uptime_handler(struct http_client_ctx *client, enum http_transaction_status status,
			  const struct http_request_ctx *request_ctx,
			  struct http_response_ctx *response_ctx, void *user_data)
{
	static uint8_t body[48];

	ARG_UNUSED(client);
	ARG_UNUSED(request_ctx);
	ARG_UNUSED(user_data);

	if (status != HTTP_SERVER_REQUEST_DATA_FINAL) {
		return 0;
	}

	response_ctx->body_len = snprintf((char *)body, sizeof(body), "{\"uptime_ms\":%lld}\n",
					  k_uptime_get());
	response_ctx->body = body;
	response_ctx->final_chunk = true;

	return 0;
}

static struct http_resource_detail_dynamic uptime_resource_detail = {
	.common = {
		.type = HTTP_RESOURCE_TYPE_DYNAMIC,
		.bitmask_of_supported_http_methods = BIT(HTTP_GET),
		.content_type = "application/json",
	},
	.cb = uptime_handler,
	.user_data = NULL,
};

HTTP_RESOURCE_DEFINE(uptime_resource, bare_service, "/uptime", &uptime_resource_detail);

/*
 * ---------------------------------------------------------------------------
 * Application side: raw bytes in, raw bytes out.
 * ---------------------------------------------------------------------------
 */

static K_SEM_DEFINE(response_done, 0, 1);

/**
 * @brief Placeholder for "the HTTP server produced these bytes".
 *
 * Replace the body with a write to your real link. Remember that this is a
 * byte stream: @p len is whatever happened to be available, not a message.
 */
static void on_server_data(const uint8_t *data, size_t len, void *user_data)
{
	ARG_UNUSED(user_data);

	if (data == NULL) {
		LOG_INF("<-- connection closed by the server");
		k_sem_give(&response_done);
		return;
	}

	LOG_INF("<-- %zu bytes from the HTTP server:", len);
	printk("%.*s", (int)len, data);
}

/**
 * @brief Placeholder for "my link received these bytes, hand them to the server".
 *
 * The request is split into two writes on purpose: the server does not care
 * about buffer boundaries, so it may arrive in as many pieces as you like.
 */
static void do_request(const char *request)
{
	size_t len = strlen(request);
	size_t first = len / 2;
	struct bare_conn *conn;
	int ret;

	conn = bare_http_conn_open(on_server_data, NULL);
	if (conn == NULL) {
		LOG_ERR("Cannot open a bare connection");
		return;
	}

	LOG_INF("--> feeding %zu bytes in two chunks", len);

	ret = bare_http_input(conn, request, first);
	if (ret == 0) {
		ret = bare_http_input(conn, request + first, len - first);
	}

	if (ret < 0) {
		LOG_ERR("bare_http_input failed (%d)", ret);
	} else if (k_sem_take(&response_done, K_SECONDS(5)) != 0) {
		/* The request carries "Connection: close", so the server hangs
		 * up once the response is out.
		 */
		LOG_WRN("Timed out waiting for the response");
	}

	bare_http_conn_close(conn);
}

int main(void)
{
	int ret;

	ret = http_server_start();
	if (ret < 0) {
		LOG_ERR("Cannot start the HTTP server (%d)", ret);
		return ret;
	}

	/* Let the server thread reach its poll() before queueing a connection.
	 * Queueing early is harmless, this only keeps the log output readable.
	 */
	k_sleep(K_MSEC(100));

	/* Static resource. */
	do_request("GET / HTTP/1.1\r\n"
		   "Host: bare\r\n"
		   "Connection: close\r\n"
		   "\r\n");

	/* Dynamic resource, handled by uptime_handler() above. */
	do_request("GET /uptime HTTP/1.1\r\n"
		   "Host: bare\r\n"
		   "Connection: close\r\n"
		   "\r\n");

	LOG_INF("Done");

	return 0;
}
```

## src/main.cpp
```c
/*
 * Copyright (c) 2026 Zephyr Project contributors
 *
 * SPDX-License-Identifier: Apache-2.0
 */

/**
 * @file
 * @brief Serving files over HTTP with bare data buffers.
 *
 * There is no network stack in this image: no L2 driver, no IP, no TCP, no
 * sockets. A UART is wired straight into RawHttpServer, so bytes arriving on
 * the wire become HTTP requests and the responses go back out of the same
 * UART. GET downloads a file; that is the whole surface.
 */

#include <errno.h>
#include <string.h>

#include <zephyr/fs/fs.h>
#include <zephyr/fs/littlefs.h>
#include <zephyr/kernel.h>
#include <zephyr/logging/log.h>
#include <zephyr/net_buf.h>
#include <zephyr/storage/flash_map.h>

#include <raw_http_server.hpp>

#include "uart_bridge.hpp"

LOG_MODULE_REGISTER(http_server_bare, LOG_LEVEL_INF);

/*
 * The URL is the filesystem path, so whatever is mounted is servable at its
 * mount point: this littlefs at /lfs makes "GET /lfs/hello.txt" work. A real
 * board typically mounts its storage during boot and mounts nothing here.
 */
#define FILES_MOUNT_POINT "/lfs"

FS_LITTLEFS_DECLARE_DEFAULT_CONFIG(storage);
static struct fs_mount_t files_mount = {
    .type = FS_LITTLEFS,
    .mnt_point = FILES_MOUNT_POINT,
    .fs_data = &storage,
    .storage_dev = (void*)PARTITION_ID(storage_partition),
};

/* GET is the whole surface, so the multi-chunk test file cannot be uploaded;
 * seed it at boot instead. The size exceeds CONFIG_RAW_HTTP_FILE_CHUNK, so
 * downloading it takes several chunks, and the pattern is position-dependent,
 * mirrored by the test suite's payload_of(): a mismatch shows its offset.
 */
#define BIG_FILE_SIZE 5035

/* Write one file, overwriting; fail loudly on a short write. */
static int seed_file(const char* path, const uint8_t* body, size_t len) {
  struct fs_file_t file;
  int ret;

  fs_file_t_init(&file);

  ret = fs_open(&file, path, FS_O_CREATE | FS_O_WRITE | FS_O_TRUNC);
  if (ret < 0) {
    return ret;
  }

  ret = fs_write(&file, body, len);
  (void)fs_close(&file);

  /* A short write (e.g. no free space) would silently truncate the demo. */
  if (ret >= 0 && ret != (int)len) {
    return -EIO;
  }

  return ret < 0 ? ret : 0;
}

/* Files to download, so the sample has something to serve out of the box. */
static int seed_demo_files(void) {
  static const char body[] = "hello from the bare HTTP server\n";
  static uint8_t big[BIG_FILE_SIZE];
  int ret;

  ret = seed_file(FILES_MOUNT_POINT "/hello.txt", (const uint8_t*)body,
                  sizeof(body) - 1);
  if (ret < 0) {
    return ret;
  }

  for (size_t i = 0; i < sizeof(big); i++) {
    big[i] = (uint8_t)(i * 7 + i / 251);
  }

  return seed_file(FILES_MOUNT_POINT "/big.bin", big, sizeof(big));
}

/* Packet size only sets how RX bytes are chunked on the way to the server. */
#define HTTP_PACKET_SIZE 1024
#define HTTP_PACKET_COUNT 8

NET_BUF_POOL_DEFINE(http_packet_pool,
                    HTTP_PACKET_COUNT,
                    HTTP_PACKET_SIZE,
                    0,
                    NULL);

/* The UART carrying HTTP. Constructing the bridge starts the server's thread,
 * which is safe at namespace scope; the UART side happens in start().
 */
static UartBridge bridge(DEVICE_DT_GET(DT_ALIAS(http_uart)), &http_packet_pool);

#if defined(CONFIG_APP_SELFTEST)
/*
 * Inject a few requests directly, so the sample demonstrates itself without a
 * terminal attached. The responses go out of the UART like any other.
 */
static const char* const selftest_requests[] = {
    /* download the seeded file -> 200 */
    "GET " FILES_MOUNT_POINT "/hello.txt HTTP/1.1\r\nHost: bare\r\n\r\n",
    /* a missing file -> 404, and the next request is unaffected */
    "GET " FILES_MOUNT_POINT "/missing.txt HTTP/1.1\r\nHost: bare\r\n\r\n",
    /* an upload -> 405, its body skipped exactly: GET is the surface */
    "PUT " FILES_MOUNT_POINT
    "/upload.txt HTTP/1.1\r\nHost: bare\r\n"
    "Content-Length: 3\r\n\r\nhi\n",
    /* bytes that are not HTTP -> a single 400, then the stream heals */
    "this is not HTTP\r\n\r\n",
    /* split across two packets on purpose: the server reassembles */
    "GET " FILES_MOUNT_POINT "/hello.txt HTTP/1.1\r\nHost: bare\r\n\r\n",
};

/* Wrap a slice of a request in a packet and queue it for the server. */
static int enqueue_selftest_bytes(RawHttpServer& server,
                                  const char* bytes,
                                  size_t len) {
  struct net_buf* packet = net_buf_alloc(&http_packet_pool, K_FOREVER);
  int ret;

  net_buf_add_mem(packet, bytes, len);

  ret = server.enqueue_packet(packet);
  if (ret < 0) {
    net_buf_unref(packet);
  }

  return ret;
}

static void run_selftest(RawHttpServer& server) {
  ARRAY_FOR_EACH(selftest_requests, i) {
    const char* request = selftest_requests[i];
    size_t len = strlen(request);
    /* The last request goes in two packets to demonstrate reassembly;
     * the others each ride one packet. The responses come out of the
     * UART asynchronously, from the server's thread.
     */
    size_t first = (i == ARRAY_SIZE(selftest_requests) - 1) ? len / 2 : len;
    int ret;

    LOG_INF("--> request %zu: %zu bytes in %s", i + 1, len,
            first == len ? "one packet" : "two packets");

    ret = enqueue_selftest_bytes(server, request, first);
    if (ret == 0 && first < len) {
      ret = enqueue_selftest_bytes(server, request + first, len - first);
    }

    if (ret < 0) {
      LOG_ERR("enqueue_packet failed (%d)", ret);
      return;
    }
  }
}
#endif /* CONFIG_APP_SELFTEST */

int main(void) {
  int ret;

  /* A real board would have done this during boot; the server only ever
   * receives the resulting path.
   */
  ret = fs_mount(&files_mount);
  if (ret < 0) {
    LOG_ERR("Cannot mount %s (%d)", FILES_MOUNT_POINT, ret);
    return ret;
  }

  ret = seed_demo_files();
  if (ret < 0) {
    LOG_WRN("Cannot seed the demo files (%d)", ret);
  }

  LOG_INF("Serving files from %s", FILES_MOUNT_POINT);

  ret = bridge.start();
  if (ret < 0) {
    LOG_ERR("Cannot wire up the UART (%d)", ret);
    return ret;
  }

#if defined(CONFIG_APP_SELFTEST)
  run_selftest(bridge.server());
  LOG_INF("Self-test done, now serving the UART forever");
#endif

  /* Everything from here on is driven by the UART interrupt. */
  return 0;
}
```

## include/raw_http_server.hpp
```c
/*
 * Copyright (c) 2026 Zephyr Project contributors
 *
 * SPDX-License-Identifier: Apache-2.0
 */

/**
 * @file
 * @brief A GET-only file server for HTTP/1.1 over bare data buffers.
 *
 * No sockets, no L2, no IP, no TCP - the only Zephyr networking code involved
 * is the HTTP request parser library. The whole surface is two operations:
 *
 *   - enqueue_packet(net_buf) - chunks of the request byte stream go in
 *   - the OutputCallback given to the constructor - response bytes come out
 *
 * The request URL is the filesystem path: "GET /lfs/report.bin" serves the
 * file at /lfs/report.bin through whatever is mounted there. The VFS is the
 * validator - a URL outside every mount simply fails the filesystem call and
 * is answered with 404. The server owns a thread that drains the packet
 * queue; requests are handled strictly one at a time, in arrival order.
 *
 * Packets carry arbitrary chunks of the byte stream - the server does the
 * framing. Request heads are assembled in an internal buffer, so a request
 * may be split across any number of packets. The server answers one request
 * per client round trip: once a request is answered, everything already
 * received beyond it is dropped, so a client must read the response before
 * sending its next request. A refused request's body is never buffered:
 * it is counted down and discarded as it streams past.
 *
 * The head-assembly bound and the download chunk size are Kconfig options:
 * CONFIG_RAW_HTTP_HEAD_MAX and CONFIG_RAW_HTTP_FILE_CHUNK, plus
 * CONFIG_RAW_HTTP_URL_MAX for the URL alone. The thread is shaped by
 * CONFIG_RAW_HTTP_THREAD_STACK_SIZE and CONFIG_RAW_HTTP_THREAD_PRIORITY.
 *
 * @code
 * NET_BUF_POOL_DEFINE(my_pool, 8, 1024, 0, NULL);
 *
 * static void to_my_link(const uint8_t *data, size_t len, void *user)
 * {
 *         my_link_write(data, len);
 * }
 *
 * static RawHttpServer server(to_my_link);
 *
 * struct net_buf *packet = net_buf_alloc(&my_pool, K_FOREVER);
 * net_buf_add_mem(packet, bytes_from_my_link, n);
 * server.enqueue_packet(packet);
 * @endcode
 */

#ifndef RAW_HTTP_SERVER_HPP_
#define RAW_HTTP_SERVER_HPP_

#include <stddef.h>
#include <stdint.h>

#include <zephyr/kernel.h>
#include <zephyr/net/http/parser.h>
#include <zephyr/net_buf.h>

/**
 * @brief Serve file downloads over HTTP/1.1, on a raw byte stream.
 *
 * The "connection" is whatever byte pipe the caller owns, so it never opens
 * or closes. Every request gets exactly one response: 200 with the file, or
 * 404 (nothing servable at that path), 405 (not a GET), 414 (URL too long),
 * 431 (head outgrew the assembly buffer), 400 (malformed, chunked, or an
 * upgrade). An incomplete request is simply waited on - the head completes
 * whenever its bytes arrive. A request sent ahead of the previous response
 * is dropped, never answered - its tail may later parse as garbage and
 * earn a stray 400, from which the stream self-heals. Unparseable bytes
 * cost a single 400 and a stream reset; the stream self-heals at the next
 * request boundary.
 *
 * All parsing, file I/O and response generation happen on the server's own
 * thread, which is the only thread touching any request state - so the class
 * needs no lock. enqueue_packet() only touches the packet queue and may be
 * called from any thread or from an ISR.
 */
class RawHttpServer {
 public:
  /**
   * @brief Response bytes produced by the server.
   *
   * Invoked from the server's thread. Write the bytes onto your real
   * link - a UART, a USB endpoint, shared memory, a test harness.
   *
   * @note The payload is a byte stream: one response may arrive over
   *       several calls. Never assume a fixed size - @p len is whatever
   *       the server produced in one go.
   *
   * @note The bytes are valid only during the call: copy or transmit
   *       them before returning.
   *
   * @param data Bytes to transmit. Never nullptr.
   * @param len Number of valid bytes at @p data. Never 0.
   * @param user_data The pointer handed to the constructor.
   */
  using OutputCallback = void (*)(const uint8_t* data,
                                  size_t len,
                                  void* user_data);

  /**
   * @brief Construct the server and start its thread.
   *
   * Files are served from whatever filesystems are mounted - the URL is
   * the filesystem path, so a mount at "/lfs" serves "GET /lfs/...".
   * Nothing is created or mounted here.
   *
   * @param output_callback Callback receiving response bytes. Must not be
   * nullptr.
   * @param user_data Opaque pointer forwarded to @p output_callback.
   */
  RawHttpServer(OutputCallback output_callback, void* user_data = nullptr);

  /**
   * @brief Stop the server thread and release everything it held.
   *
   * Best-effort: destroying mid-request simply drops that exchange.
   */
  ~RawHttpServer();

  RawHttpServer(const RawHttpServer&) = delete;
  RawHttpServer& operator=(const RawHttpServer&) = delete;

  /**
   * @brief Hand a chunk of the request byte stream to the server.
   *
   * Packets are arbitrary chunks: a request may span any number of
   * packets - the server reassembles it. One request is answered per
   * round trip: bytes received beyond the answered request are dropped,
   * so do not send a request before reading the previous response. A
   * zero-length packet carries no bytes and is dropped silently.
   *
   * Ownership of @p packet passes to the server (and stays with the
   * caller on error). Flat buffers only - fragment chains are rejected.
   *
   * Safe to call from any thread or from an ISR.
   *
   * @return 0 on success, -EINVAL on a nullptr or chained packet.
   */
  int enqueue_packet(struct net_buf* packet);

 private:
  /**
   * @brief Parser callback: capture the URL.
   *
   * Called at most once per parse attempt - a URL split across packets
   * is re-seen whole here on the next attempt, because every attempt
   * re-parses from the buffer start. Fails the parse on overflow -
   * process_request() reads that back as HPE_CB_url and answers 414
   * rather than truncating silently.
   */
  static int on_url(struct http_parser* parser, const char* at, size_t length);

  /**
   * @brief Parser callback: the head is complete - halt the parser.
   *
   * Always returns nonzero, on purpose: the head is everything a
   * GET-only server needs, so the body is never parsed - it is skipped
   * by Content-Length in process_request(). The resulting
   * HPE_CB_headers_complete errno is process_request()'s success
   * verdict.
   */
  static int on_headers_complete(struct http_parser* parser);

  /**
   * @brief Thread entry trampoline, matching k_thread_entry_t.
   */
  static void run_trampoline(void* p1, void* p2, void* p3);

  /**
   * @brief The server thread: take packets off the queue, forever.
   *
   * Every non-empty packet goes to handle_packet(). Everything - the
   * parser, file I/O, the output callback - runs here, so nothing else
   * can interleave with a request.
   */
  void run_loop();

  /**
   * @brief Feed one packet of stream bytes through the server.
   *
   * Two consumers take the packet in order: discard() strips body
   * bytes owed to the previously answered request off the front, then
   * what fits of the rest is appended to _request_buf and
   * process_request() makes one parse attempt. A head that outgrows a
   * full buffer is answered with 431 and the buffer reset. Once a
   * request is answered the packet's remainder is dropped - through
   * discard() again, since it may be that request's own body - so at
   * most one response leaves per packet.
   */
  void handle_packet(const struct net_buf* packet);

  /**
   * @brief Pay down the answered request's body debt from stream bytes.
   *
   * Consumes up to @p available bytes against _body_to_discard. This is
   * the only place the debt is ever decremented, so every discard site
   * reads identically - and the size_t/uint64_t care lives here alone
   * (the debt can exceed SIZE_MAX on 32-bit targets).
   *
   * @param available Contiguous stream bytes on offer.
   * @return How many of them the debt consumed (at most @p available).
   */
  size_t discard(size_t available);

  /**
   * @brief One parse attempt over _request_buf; answer if it completes.
   *
   * Reinitialises the parser and parses the buffer from the start, so
   * no parser state survives between packets.
   * on_headers_complete() halts the parser at the end of the head,
   * which makes the parser's errno the whole verdict:
   * HPE_CB_headers_complete is success, HPE_OK means the head is
   * still incomplete (wait for more bytes), HPE_CB_url is an overlong
   * URL (414), anything else is malformed bytes (400). On success the
   * request is answered (upgrade/CONNECT 400, chunked 400, non-GET
   * 405, GET served), the full Content-Length is armed as
   * _body_to_discard, the bytes already buffered past the head pay it
   * down through discard() - they are dropped with the buffer reset -
   * and the body remainder still in flight is discarded on arrival.
   *
   * @return true if a response was sent, false if the head is still
   *         incomplete.
   */
  bool process_request();

  /**
   * @brief Serve the GET: open the file, send the head, stream the body.
   *
   * The URL is the path. The size comes from fs_stat(), so the response
   * carries a plain Content-Length - no chunked encoding. Anything that
   * cannot be stat'd or opened, or is not a regular file, is a 404.
   * Body chunks are read into _out_buf, one output callback per chunk.
   */
  void send_file();

  /** @brief Stage a response head in _out_buf and emit it. */
  void respond(unsigned int status, size_t content_length);

  /** The parser callbacks, shared by every instance. */
  static const struct http_parser_settings _settings;

  OutputCallback _output_callback;
  void* _user_data;

  struct http_parser _parser{};

  /** Packets from enqueue_packet(), consumed only by the server thread. */
  struct k_fifo _rx_fifo{};
  struct k_thread _thread{};
  K_KERNEL_STACK_MEMBER(_stack, CONFIG_RAW_HTTP_THREAD_STACK_SIZE);

  /** Response staging: heads and download chunks alike. */
  uint8_t _out_buf[CONFIG_RAW_HTTP_FILE_CHUNK]{};

  /** Request heads are assembled here from the incoming packets. */
  uint8_t _request_buf[CONFIG_RAW_HTTP_HEAD_MAX]{};
  size_t _request_len{0};

  /** Body bytes still owed to an answered request, discarded on arrival. */
  uint64_t _body_to_discard{0};

  /* Per-parse state, reset by process_request() before each attempt. */
  char _url[CONFIG_RAW_HTTP_URL_MAX]{};
};

#endif /* RAW_HTTP_SERVER_HPP_ */
```

## include/uart_bridge.hpp
```c
/*
 * Copyright (c) 2026 Zephyr Project contributors
 *
 * SPDX-License-Identifier: Apache-2.0
 */

/**
 * @file
 * @brief Wire a UART straight into a RawHttpServer.
 *
 * Bytes received on the UART become HTTP requests, and the HTTP responses go
 * back out of the same UART. Nothing sits in between.
 *
 * RawHttpServer knows nothing about this class: it only ever sees buffers.
 */

#ifndef UART_BRIDGE_HPP_
#define UART_BRIDGE_HPP_

#include <zephyr/device.h>
#include <zephyr/kernel.h>
#include <zephyr/sys/ring_buffer.h>

#include "raw_http_server.hpp"

class UartBridge {
public:
	/**
	 * @param uart The UART carrying the HTTP byte stream.
	 * @param fs_root Already-mounted directory files are served from.
	 */
	UartBridge(const struct device *uart, const char *fs_root)
		: _uart(uart), _server(on_server_output, fs_root, this)
	{
	}

	UartBridge(const UartBridge &) = delete;
	UartBridge &operator=(const UartBridge &) = delete;

	/**
	 * @brief Attach the server to the UART and start serving.
	 *
	 * @return 0 on success, negative errno otherwise.
	 */
	int start();

	/** @brief The underlying server, for injecting requests directly. */
	RawHttpServer &server()
	{
		return _server;
	}

private:
	/**
	 * @brief Server -> UART trampoline, matching RawHttpServer::OutputCallback.
	 *
	 * Recovers the UartBridge from @p user_data and forwards to
	 * write_to_uart().
	 */
	static void on_server_output(const uint8_t *data, size_t len, void *user_data);

	/**
	 * @brief Transmit response bytes on the UART.
	 *
	 * Runs on whichever thread called RawHttpServer::input(), so blocking
	 * is allowed. uart_poll_out() busy-waits per byte, which is fine at
	 * sane baud rates and keeps this portable; switch to interrupt-driven
	 * TX with a second ring buffer to push large responses at high speed.
	 */
	void write_to_uart(const uint8_t *data, size_t len);

	/**
	 * @brief UART ISR trampoline, matching uart_irq_callback_user_data_t.
	 */
	static void isr_trampoline(const struct device *dev, void *user_data);

	/**
	 * @brief UART ISR: move received bytes into the RX ring.
	 *
	 * Only moves bytes and gives the semaphore - the server may block on
	 * file I/O, which must never happen in an ISR. A full ring drops
	 * bytes (loudly): dropping beats blocking here.
	 */
	void isr(const struct device *dev);

	/**
	 * @brief Feed thread trampoline, matching k_thread_entry_t.
	 */
	static void feed_trampoline(void *p1, void *p2, void *p3);

	/**
	 * @brief Drain the RX ring into the server, forever.
	 *
	 * Sleeps on the semaphore until the ISR signals new bytes, then hands
	 * them to RawHttpServer::input() - which does the parsing, the file
	 * I/O and the response transmission before it returns.
	 */
	void feed_loop();

	const struct device *_uart;
	RawHttpServer _server;
	struct ring_buf _rx_ring {};
	/** Absorbs bytes arriving while input() is busy with file I/O. */
	uint8_t _rx_ring_buf[CONFIG_RAW_HTTP_UART_RING_SIZE]{};
	struct k_sem _rx_sem {};
	struct k_thread _feed_thread {};
};

#endif /* UART_BRIDGE_HPP_ */
```

## src/bare_http.cpp
```c
/*
 * Copyright (c) 2026 Zephyr Project contributors
 *
 * SPDX-License-Identifier: Apache-2.0
 */

#include <errno.h>
#include <string.h>

#include <zephyr/kernel.h>
#include <zephyr/logging/log.h>
#include <zephyr/net/http/server.h>
#include <zephyr/net/socket.h>
#include <zephyr/sys/fdtable.h>

#include "bare_http.hpp"

LOG_MODULE_REGISTER(bare_http, LOG_LEVEL_INF);

#define BARE_MAX_PENDING   2
#define BARE_RX_STACK_SIZE 1024
#define BARE_RX_PRIORITY   K_PRIO_PREEMPT(8)

/* How long poll() parks before rechecking running_. Bounds how long stop()
 * takes; an idle link costs one wakeup per interval and nothing else.
 */
#define BARE_POLL_TIMEOUT_MS 500

K_THREAD_STACK_DEFINE(bare_rx_stack, BARE_RX_STACK_SIZE);

namespace
{

/*
 * The listening socket.
 *
 * The HTTP server only ever does four things with it: setsockopt(), bind(),
 * listen(), then poll()+accept() in a loop. bind() and listen() are no-ops
 * here, poll() is backed by a k_poll_signal, and accept() pops a socketpair end
 * that BareHttpServer::link() queued.
 *
 * It is deliberately a singleton: HTTP_SERVICE_DEFINE() registers exactly one
 * service, and this sample serves exactly one client.
 */
struct Listener {
	struct k_poll_signal acceptSig;
	struct k_spinlock lock;
	int pending[BARE_MAX_PENDING];
	uint8_t pendingCount;
	bool inUse;
};

Listener listener;
struct socket_op_vtable listenerVtable;

ssize_t listenerRead(void *obj, void *buf, size_t sz)
{
	ARG_UNUSED(obj);
	ARG_UNUSED(buf);
	ARG_UNUSED(sz);

	errno = EOPNOTSUPP;
	return -1;
}

ssize_t listenerWrite(void *obj, const void *buf, size_t sz)
{
	ARG_UNUSED(obj);
	ARG_UNUSED(buf);
	ARG_UNUSED(sz);

	errno = EOPNOTSUPP;
	return -1;
}

int listenerClose(void *obj)
{
	int fds[BARE_MAX_PENDING];
	uint8_t count;

	ARG_UNUSED(obj);

	k_spinlock_key_t key = k_spin_lock(&listener.lock);

	count = listener.pendingCount;
	memcpy(fds, listener.pending, count * sizeof(fds[0]));
	listener.pendingCount = 0;
	listener.inUse = false;

	k_spin_unlock(&listener.lock, key);

	/* Drop connections that were queued but never accepted. */
	for (uint8_t i = 0; i < count; i++) {
		(void)zsock_close(fds[i]);
	}

	return 0;
}

int listenerPollPrepare(struct zsock_pollfd *pfd, struct k_poll_event **pev,
			struct k_poll_event *pev_end)
{
	if ((pfd->events & ZSOCK_POLLIN) == 0) {
		return 0;
	}

	if (*pev == pev_end) {
		errno = ENOMEM;
		return -1;
	}

	/* Clear a stale signal before blocking. Anything queued after this
	 * point raises the signal again and wakes the poll up.
	 */
	k_spinlock_key_t key = k_spin_lock(&listener.lock);

	if (listener.pendingCount == 0) {
		k_poll_signal_reset(&listener.acceptSig);
	}

	k_spin_unlock(&listener.lock, key);

	(*pev)->obj = &listener.acceptSig;
	(*pev)->type = K_POLL_TYPE_SIGNAL;
	(*pev)->mode = K_POLL_MODE_NOTIFY_ONLY;
	(*pev)->state = K_POLL_STATE_NOT_READY;
	(*pev)++;

	return 0;
}

int listenerPollUpdate(struct zsock_pollfd *pfd, struct k_poll_event **pev)
{
	if ((pfd->events & ZSOCK_POLLIN) == 0) {
		return 0;
	}

	/* Readiness comes from the queue, not from the signal state. */
	k_spinlock_key_t key = k_spin_lock(&listener.lock);

	if (listener.pendingCount > 0) {
		pfd->revents |= ZSOCK_POLLIN;
	}

	k_spin_unlock(&listener.lock, key);

	(*pev)++;

	return 0;
}

int listenerIoctl(void *obj, unsigned int request, va_list args)
{
	ARG_UNUSED(obj);

	switch (request) {
	case ZFD_IOCTL_POLL_PREPARE: {
		struct zsock_pollfd *pfd = va_arg(args, struct zsock_pollfd *);
		struct k_poll_event **pev = va_arg(args, struct k_poll_event **);
		struct k_poll_event *pev_end = va_arg(args, struct k_poll_event *);

		return listenerPollPrepare(pfd, pev, pev_end);
	}

	case ZFD_IOCTL_POLL_UPDATE: {
		struct zsock_pollfd *pfd = va_arg(args, struct zsock_pollfd *);
		struct k_poll_event **pev = va_arg(args, struct k_poll_event **);

		return listenerPollUpdate(pfd, pev);
	}

	default:
		errno = EOPNOTSUPP;
		return -1;
	}
}

int listenerBind(void *obj, const struct net_sockaddr *addr, net_socklen_t addrlen)
{
	ARG_UNUSED(obj);
	ARG_UNUSED(addr);
	ARG_UNUSED(addrlen);

	/* There is no address space to bind to; accept the call so that
	 * http_server_init() keeps going.
	 */
	return 0;
}

int listenerListen(void *obj, int backlog)
{
	ARG_UNUSED(obj);
	ARG_UNUSED(backlog);

	return 0;
}

int listenerAccept(void *obj, struct net_sockaddr *addr, net_socklen_t *addrlen)
{
	int fd;

	ARG_UNUSED(obj);
	ARG_UNUSED(addr);

	k_spinlock_key_t key = k_spin_lock(&listener.lock);

	if (listener.pendingCount == 0) {
		k_spin_unlock(&listener.lock, key);
		errno = EAGAIN;
		return -1;
	}

	fd = listener.pending[0];
	listener.pendingCount--;
	memmove(&listener.pending[0], &listener.pending[1],
		listener.pendingCount * sizeof(listener.pending[0]));

	k_spin_unlock(&listener.lock, key);

	/* Report an empty peer address. The caller zeroes the storage first, so
	 * it stays NET_AF_UNSPEC.
	 */
	if (addrlen != nullptr) {
		*addrlen = 0;
	}

	return fd;
}

int listenerGetsockopt(void *obj, int level, int optname, void *optval, net_socklen_t *optlen)
{
	ARG_UNUSED(obj);
	ARG_UNUSED(level);
	ARG_UNUSED(optname);

	/* Only ever reached through the server's SO_ERROR read on POLLERR,
	 * which this listener never reports.
	 */
	if (optval != nullptr && optlen != nullptr && *optlen >= sizeof(int)) {
		*static_cast<int *>(optval) = 0;
		*optlen = sizeof(int);
	}

	return 0;
}

int listenerSetsockopt(void *obj, int level, int optname, const void *optval, net_socklen_t optlen)
{
	ARG_UNUSED(obj);
	ARG_UNUSED(level);
	ARG_UNUSED(optname);
	ARG_UNUSED(optval);
	ARG_UNUSED(optlen);

	/* SO_REUSEADDR and friends are meaningless here, but the server
	 * abandons the service if setsockopt() fails.
	 */
	return 0;
}

/* Filled in field by field rather than with a designated initialiser, because
 * fd_op_vtable puts read/write/close inside anonymous unions.
 */
void initListenerVtable()
{
	listenerVtable.fd_vtable.read = listenerRead;
	listenerVtable.fd_vtable.write = listenerWrite;
	listenerVtable.fd_vtable.close = listenerClose;
	listenerVtable.fd_vtable.ioctl = listenerIoctl;
	listenerVtable.bind = listenerBind;
	listenerVtable.listen = listenerListen;
	listenerVtable.accept = listenerAccept;
	listenerVtable.getsockopt = listenerGetsockopt;
	listenerVtable.setsockopt = listenerSetsockopt;
}

/* Queue an accepted descriptor and wake the server's poll() up. */
int listenerPush(int fd)
{
	k_spinlock_key_t key = k_spin_lock(&listener.lock);

	if (!listener.inUse) {
		k_spin_unlock(&listener.lock, key);
		return -ENOTCONN;
	}

	if (listener.pendingCount == ARRAY_SIZE(listener.pending)) {
		k_spin_unlock(&listener.lock, key);
		return -ENOSPC;
	}

	listener.pending[listener.pendingCount++] = fd;

	k_spin_unlock(&listener.lock, key);

	/* Must be raised outside the spinlock, it may reschedule. */
	k_poll_signal_raise(&listener.acceptSig, 0);

	return 0;
}

/* The running instance, so the RX thread trampoline can find it. */
BareHttpServer *instance;

} /* namespace */

int BareHttpServer::socketCreate(const struct http_service_desc *svc, int af, int proto)
{
	int fd;

	ARG_UNUSED(svc);
	ARG_UNUSED(af);
	ARG_UNUSED(proto);

	fd = zvfs_reserve_fd();
	if (fd < 0) {
		errno = EMFILE;
		return -1;
	}

	initListenerVtable();
	k_poll_signal_init(&listener.acceptSig);
	listener.pendingCount = 0;
	listener.inUse = true;

	zvfs_finalize_typed_fd(fd, &listener,
			       reinterpret_cast<const struct fd_op_vtable *>(&listenerVtable),
			       ZVFS_MODE_IFSOCK);

	LOG_DBG("Bare listening socket created (fd %d)", fd);

	return fd;
}

void BareHttpServer::rxTrampoline(void *p1, void *p2, void *p3)
{
	ARG_UNUSED(p2);
	ARG_UNUSED(p3);

	static_cast<BareHttpServer *>(p1)->rxLoop();
}

void BareHttpServer::rxLoop()
{
	bool eof = false;

	while (running_ && !eof) {
		struct zsock_pollfd pfd = {
			.fd = appFd_,
			.events = ZSOCK_POLLIN,
			.revents = 0,
		};

		/* The timeout is what lets stop() retire this thread; the fd
		 * must stay open while we are parked in poll().
		 */
		int ret = zsock_poll(&pfd, 1, BARE_POLL_TIMEOUT_MS);

		if (ret < 0) {
			LOG_DBG("poll failed (%d)", -errno);
			break;
		}

		if (ret == 0) {
			continue;
		}

		if ((pfd.revents & ZSOCK_POLLIN) == 0) {
			if (pfd.revents & (ZSOCK_POLLERR | ZSOCK_POLLHUP)) {
				break;
			}
			continue;
		}

		/* Short reads are normal: this delivers whatever is buffered,
		 * never a fixed-size frame.
		 */
		ssize_t got = zsock_recv(appFd_, rxBuf_, sizeof(rxBuf_), 0);

		if (got > 0) {
			cb_(rxBuf_, static_cast<size_t>(got), userData_);
			continue;
		}

		if (got == 0) {
			LOG_DBG("HTTP server closed the connection");
			eof = true;
		} else if (errno != EAGAIN && errno != EWOULDBLOCK) {
			LOG_DBG("recv failed (%d)", -errno);
			eof = true;
		}
	}

	/* The next input() relinks transparently. */
	linked_ = false;

	/* End-of-stream marker for the application. */
	cb_(nullptr, 0, userData_);
}

/* Caller must hold lock_. */
int BareHttpServer::link()
{
	int sv[2];
	int ret;

	/* A previous RX thread may still be unwinding. It must be fully gone
	 * before its stack is handed to a new one.
	 */
	if (threadStarted_) {
		(void)k_thread_join(&thread_, K_FOREVER);
		threadStarted_ = false;
	}

	ret = zsock_socketpair(NET_AF_UNIX, NET_SOCK_STREAM, 0, sv);
	if (ret < 0) {
		return -errno;
	}

	/*
	 * Our end must be non-blocking. Every zsock_*() call holds a per-fd
	 * mutex for its whole duration (VTABLE_CALL in subsys/net/lib/sockets/
	 * sockets.c), so a blocking recv() parked on this descriptor would lock
	 * out send() on the same descriptor from any other thread - a hard
	 * deadlock as soon as one connection serves more than one request.
	 * With O_NONBLOCK nothing blocks inside the mutex, and poll() - which
	 * does not hold it while waiting - provides the blocking instead.
	 *
	 * The server's end stays blocking: that is what its own code expects.
	 */
	if (zsock_fcntl(sv[0], ZVFS_F_SETFL, ZVFS_O_NONBLOCK) < 0) {
		ret = -errno;
		(void)zsock_close(sv[0]);
		(void)zsock_close(sv[1]);
		return ret;
	}

	/* sv[1] becomes the HTTP server's client socket, sv[0] stays with us. */
	ret = listenerPush(sv[1]);
	if (ret < 0) {
		(void)zsock_close(sv[0]);
		(void)zsock_close(sv[1]);
		return ret;
	}

	appFd_ = sv[0];
	linked_ = true;
	running_ = true;

	k_thread_create(&thread_, bare_rx_stack, K_THREAD_STACK_SIZEOF(bare_rx_stack),
			rxTrampoline, this, nullptr, nullptr, BARE_RX_PRIORITY, 0, K_NO_WAIT);
	(void)k_thread_name_set(&thread_, "bare_rx");
	threadStarted_ = true;

	return 0;
}

int BareHttpServer::start()
{
	int ret;

	if (cb_ == nullptr) {
		return -EINVAL;
	}

	if (started_) {
		return 0;
	}

	if (instance != nullptr) {
		LOG_ERR("Another BareHttpServer is already running");
		return -EEXIST;
	}

	ret = http_server_start();
	if (ret < 0) {
		LOG_ERR("Cannot start the HTTP server (%d)", ret);
		return ret;
	}

	k_mutex_init(&lock_);
	instance = this;
	started_ = true;

	/* Let the server thread reach its poll() and create the listening
	 * socket before queueing a connection onto it.
	 */
	k_sleep(K_MSEC(100));

	k_mutex_lock(&lock_, K_FOREVER);
	ret = link();
	k_mutex_unlock(&lock_);

	if (ret < 0) {
		LOG_ERR("Cannot establish the connection (%d)", ret);
		instance = nullptr;
		started_ = false;
		return ret;
	}

	return 0;
}

int BareHttpServer::input(const void *buffer, size_t size)
{
	const uint8_t *ptr = static_cast<const uint8_t *>(buffer);
	int ret = 0;

	if (!started_) {
		return -ENOTCONN;
	}

	k_mutex_lock(&lock_, K_FOREVER);

	/* The server hangs up on a malformed request, and on its inactivity
	 * timeout where the transport supports shutdown(). Relink so the link
	 * keeps serving instead of going dead for good.
	 */
	if (!linked_) {
		LOG_INF("Reconnecting to the HTTP server");
		ret = link();
		if (ret < 0) {
			LOG_ERR("Relink failed (%d)", ret);
			goto out;
		}
	}

	while (size > 0) {
		ssize_t sent = zsock_send(appFd_, ptr, size, 0);

		if (sent > 0) {
			ptr += sent;
			size -= sent;
			continue;
		}

		if (sent < 0 && errno != EAGAIN && errno != EWOULDBLOCK) {
			ret = -errno;
			goto out;
		}

		/* The server has not drained its side yet. Wait for room here
		 * rather than inside the socket call, so the RX thread can keep
		 * draining responses meanwhile.
		 */
		struct zsock_pollfd pfd = {
			.fd = appFd_,
			.events = ZSOCK_POLLOUT,
			.revents = 0,
		};

		if (zsock_poll(&pfd, 1, BARE_POLL_TIMEOUT_MS) < 0) {
			ret = -errno;
			goto out;
		}

		if (pfd.revents & (ZSOCK_POLLERR | ZSOCK_POLLHUP)) {
			ret = -ECONNRESET;
			goto out;
		}
	}

out:
	k_mutex_unlock(&lock_);

	return ret;
}

void BareHttpServer::stop()
{
	if (!started_) {
		return;
	}

	k_mutex_lock(&lock_, K_FOREVER);

	started_ = false;
	linked_ = false;

	/* Retire the RX thread first: it is parked in poll() on appFd_, and the
	 * descriptor must stay valid until it is gone. It notices within one
	 * poll timeout.
	 */
	running_ = false;

	if (threadStarted_) {
		(void)k_thread_join(&thread_, K_FOREVER);
		threadStarted_ = false;
	}

	(void)zsock_close(appFd_);
	appFd_ = -1;

	instance = nullptr;

	k_mutex_unlock(&lock_);
}

BareHttpServer::~BareHttpServer()
{
	stop();
}
```

## src/bare_http.hpp
```c
/*
 * Copyright (c) 2026 Zephyr Project contributors
 *
 * SPDX-License-Identifier: Apache-2.0
 */

/**
 * @file
 * @brief Bare (network-less) front end for the Zephyr HTTP server.
 *
 * The HTTP server always talks to its peers through a socket, but it never
 * cares what is behind that socket. BareHttpServer exploits that: it gives the
 * stock, unmodified server a socket that is not a network socket, and exposes
 * the whole thing as two plain operations:
 *
 *   - input(buffer, size) - raw bytes go into the server
 *   - the OutputCallback given to the constructor - raw bytes come back out
 *
 * No L2 driver, no IP and no TCP is involved at any point.
 *
 * @code
 * static void toMyLink(const uint8_t *data, size_t len, void *user)
 * {
 *         my_link_write(data, len);
 * }
 *
 * static BareHttpServer server(toMyLink);
 *
 * server.start();
 * server.input(bytes_from_my_link, n);
 * @endcode
 */

#ifndef BARE_HTTP_HPP_
#define BARE_HTTP_HPP_

#include <stddef.h>
#include <stdint.h>

#include <zephyr/kernel.h>
#include <zephyr/net/http/service.h>

/** Bytes passed to the output callback at most in one go. */
#define BARE_HTTP_RX_BUF_SIZE 1600

/**
 * @brief The Zephyr HTTP server, driven by bare data buffers.
 *
 * The connection is persistent. An HTTP/1.1 request that does not carry
 * "Connection: close" leaves it open, so one connection serves requests
 * indefinitely. If the server does hang up - on a malformed request, say -
 * input() re-establishes it transparently on the next call.
 *
 * @note One instance at a time. The listening socket is a process-wide
 *       singleton, so a second concurrent start() fails with -EEXIST. This is
 *       a single-client design by construction.
 */
class BareHttpServer {
public:
	/**
	 * @brief Raw bytes produced by the HTTP server.
	 *
	 * Registered through the constructor. Write them onto your real link -
	 * a UART, a USB endpoint, shared memory, a test harness.
	 *
	 * @note Invoked from the RX thread, never from the HTTP server thread.
	 *       The payload is a byte stream, so one HTTP response may arrive
	 *       over several calls, and one call may carry the tail of one
	 *       response and the head of the next. Never assume a fixed size:
	 *       @p len is whatever happened to be available.
	 *
	 * @param data Bytes from the server, or nullptr when the server hung up.
	 * @param len Valid bytes in @p data, 0 when the server hung up.
	 * @param user_data The pointer handed to the constructor.
	 */
	using OutputCallback = void (*)(const uint8_t *data, size_t len, void *user_data);

	/**
	 * @brief Construct the front end.
	 *
	 * Does no work beyond storing its arguments, so an instance is safe at
	 * namespace scope. Call start() to bring it up.
	 *
	 * @param cb Callback receiving the server's output. Must not be nullptr.
	 * @param user_data Opaque pointer forwarded to @p cb.
	 */
	explicit BareHttpServer(OutputCallback cb, void *user_data = nullptr)
		: cb_(cb), userData_(user_data)
	{
	}

	~BareHttpServer();

	BareHttpServer(const BareHttpServer &) = delete;
	BareHttpServer &operator=(const BareHttpServer &) = delete;

	/**
	 * @brief Start the HTTP server and establish the connection.
	 *
	 * @return 0 on success, -EEXIST if an instance is already running,
	 *         another negative errno otherwise.
	 */
	int start();

	/**
	 * @brief Hand a buffer of raw request bytes to the HTTP server.
	 *
	 * The buffer does not have to hold a whole request, and it may span
	 * several requests: the server parses a byte stream, not messages.
	 *
	 * @note A relink after the server hung up discards any partially
	 *       delivered request. The stream resynchronises at the next request
	 *       boundary, so whatever was in flight at that moment is lost.
	 *
	 * Blocks until every byte has been handed over, which happens when the
	 * server is slower than the caller. Never call it from the output
	 * callback, and never from an ISR.
	 *
	 * @return 0 on success, negative errno otherwise.
	 */
	int input(const void *buffer, size_t size);

	/** @brief Whether the connection to the server is currently up. */
	bool isConnected() const
	{
		return linked_;
	}

	/** @brief Tear the connection down. start() may be called again after. */
	void stop();

	/**
	 * @brief Listening socket factory, for http_service_config::socket_create.
	 *
	 * Pass this to the HTTP_SERVICE_DEFINE() that declares your resources:
	 *
	 * @code
	 * static const struct http_service_config cfg = {
	 *         .socket_create = BareHttpServer::socketCreate,
	 * };
	 * @endcode
	 */
	static int socketCreate(const struct http_service_desc *svc, int af, int proto);

private:
	int link();
	static void rxTrampoline(void *p1, void *p2, void *p3);
	void rxLoop();

	OutputCallback cb_;
	void *userData_;
	int appFd_{-1};
	struct k_mutex lock_ {};
	struct k_thread thread_ {};
	bool started_{false};
	bool linked_{false};
	bool threadStarted_{false};
	volatile bool running_{false};
	uint8_t rxBuf_[BARE_HTTP_RX_BUF_SIZE]{};
};

#endif /* BARE_HTTP_HPP_ */
```
